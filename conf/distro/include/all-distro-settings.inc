## wrlinux-distro/conf/distro/wrlinux-installer.conf
```bitbake
#@TYPE: Distro
#@NAME: Wind River Linux Installer
#@DESCRIPTION: Wind River Linux (Anaconda-based Target Installer)

require wrlinux-graphics.conf
require conf/distro/anaconda.conf
include include/wrlinux-installer-recipelists.inc

WRLINUX_VARIANT = " Installer"
DISTRO = "anaconda"

IMAGE_FSTYPES:pn-wrlinux-image-installer:append = " live"

CUSTOMIZE_LOGOS ?= "windriver-logos"

# clear WRTEMPLATE for installer image
WRTEMPLATE:anaconda = ""

# Workaround thin-provisioning-tools build failure
PREFERRED_PROVIDER_llvm-native = "clang-native"
PROVIDES:pn-clang-native = "llvm-native"
```
